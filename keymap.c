#include QMK_KEYBOARD_H
#include <stdio.h>
char wpm_str[10];
#define _LAYER0 0
#define _LAYER1 1
#define _LAYER2 2
enum custom_keycodes {
    LAYER0 = SAFE_RANGE,
    LAYER1,
    LAYER2,
};

const uint16_t PROGMEM keymaps[][MATRIX_ROWS][MATRIX_COLS] = {

    [_LAYER0] = LAYOUT_ansi(
                             KC_ESC,  KC_F1, KC_F2, KC_F3, KC_F4, KC_F5, KC_F6, KC_F7, KC_F8, KC_F9, KC_F10, KC_F11, KC_F12,                       KC_VOLD, KC_MUTE, KC_VOLU,
                             KC_GRV,  KC_1, KC_2, KC_3, KC_4, KC_5, KC_6, KC_7, KC_8, KC_9, KC_0, KC_MINS, KC_EQL, KC_BSPC,                        KC_INS,  KC_HOME, KC_PGUP,
                             KC_TAB,  KC_Q, KC_W, KC_E, KC_R, KC_T, KC_Y, KC_U, KC_I, KC_O, KC_P, KC_LBRC, KC_RBRC, KC_BSLS,                       KC_DEL,  KC_END, KC_PGDN,
                             KC_CAPS, KC_A, KC_S, KC_D, KC_F, KC_G, KC_H, KC_J, KC_K, KC_L, KC_SCLN, KC_QUOT, KC_ENT,
                             KC_LSFT, KC_Z, KC_X, KC_C, KC_V, KC_B, KC_N, KC_M, KC_COMM, KC_DOT, KC_SLSH, KC_RSFT,                                          KC_UP,
                             KC_LCTL, KC_LALT, KC_LGUI, KC_SPC, TO(1), KC_NO, KC_RALT, KC_RCTL,                                                    KC_LEFT, KC_DOWN, KC_RGHT),
        
    [_LAYER1] = LAYOUT_ansi(
                             TO(0), KC_TRNS, TO(2), KC_NO, KC_NO, KC_NO, KC_NO, KC_NO, KC_NO, KC_NO, KC_NO, KC_NO, KC_NO,                          KC_VOLD, KC_MUTE, KC_VOLU,
                             KC_NO, KC_1, KC_2, KC_3, KC_4, KC_5, KC_6, KC_7, KC_8, KC_9, KC_0, KC_NO, KC_NO, KC_BSPC,                             KC_NO,   KC_NO,   KC_NO,
                             KC_NO, KC_NO, KC_NO, LGUI(KC_RGHT), KC_NO, KC_NO, KC_NO, KC_NO, KC_NO, KC_NO, KC_NO, KC_NO, KC_NO, KC_NO,             KC_NO,   KC_NO,   KC_NO,
                             KC_NO, KC_A, KC_COMM, LGUI(KC_LEFT), KC_DOT, KC_NO, KC_NO, KC_NO, KC_NO, KC_NO, KC_NO, KC_NO, KC_ENT,
                             KC_LSFT, KC_Z, KC_NO, KC_C, KC_V, KC_NO, KC_NO, KC_NO, KC_NO, KC_COMM, KC_DOT, KC_NO,                                          KC_UP,
                             KC_LCTL, KC_LALT, KC_LGUI, KC_SPC, KC_TRNS, KC_NO, KC_NO, KC_NO,                                                      KC_LEFT, KC_DOWN, KC_RGHT),
    
    [_LAYER2] = LAYOUT_ansi(
                             TO(0), TO(1), KC_TRNS, KC_NO, KC_NO, KC_NO, KC_NO, KC_NO, KC_NO, KC_NO, KC_NO, KC_NO, KC_NO,                          KC_VOLD, KC_MUTE, KC_VOLU,
                             KC_NO, KC_1, KC_2, KC_3, KC_4, KC_5, KC_6, KC_7, KC_8, KC_9, KC_0, KC_NO, KC_NO, KC_BSPC,                             KC_NO,   KC_NO,   KC_NO,
                             KC_NO, KC_NO, LGUI(KC_EQL), KC_NO, KC_NO, KC_NO, KC_NO, KC_NO, KC_NO, KC_NO, KC_NO, KC_NO, KC_NO, KC_NO,              KC_NO,   KC_NO,   KC_NO,
                             KC_NO, LSFT(KC_LEFT), LGUI(KC_MINS), LSFT(KC_RGHT), KC_NO, KC_NO, KC_NO, KC_NO, KC_NO, KC_NO, KC_NO, KC_NO,KC_ENT,
                             KC_LSFT, KC_Z, KC_NO, KC_C, KC_V, KC_NO, KC_NO, KC_NO, KC_NO, KC_COMM, KC_DOT, KC_NO,                                          KC_UP,
                             KC_LCTL, KC_LALT, KC_LGUI, KC_SPC, KC_TRNS, KC_NO, KC_NO, KC_NO,                                                      KC_LEFT, KC_DOWN, KC_RGHT)
    
};


#ifdef OLED_DRIVER_ENABLE
#define TAP_FRAMES 2
#define IDLE_FRAMES 4
#define ANIM_FRAME_DURATION 100
#define ANIM_SIZE 584
uint32_t anim_timer = 0;
uint8_t current_tap_frame = 0;
uint8_t current_idle_frame = 0;
static const char PROGMEM idle[IDLE_FRAMES][543] = {
    {
    0,  0,126,126, 24, 60,102, 66,  0, 12, 28,112,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128,
    0,  0,  0,  0,192, 96, 48, 24, 12,132,198, 98,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  0,
    0,  0,252, 15,  1,  0,248, 14, 31,109,140,148,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  0,
    0,  0, 31,120,192,  0, 15, 56,124,219,152, 20,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  0,
    32, 16, 16, 16, 17, 11, 14, 12, 24, 16, 49, 35, 98,102, 68, 68, 71, 71, 71, 68, 68,102, 98, 35, 49, 16, 24, 12,  6,  3,  1
    },
    {
    0,  0,126,126, 24, 60,102, 66,  0, 12, 28,112,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128,
    0,  0,  0,  0,192, 96, 48, 24, 12,132,198, 98,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  0,
    0,  0,252, 15,  1,  0,248, 14, 31,109,140,148,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  0,
    0,  0, 31,120,192,  0, 15, 56,124,219,152, 20,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  0,
    32, 16, 16, 16, 17, 11, 14, 12, 24, 16, 49, 35, 98,102, 68, 68, 71, 71, 71, 68, 68,102, 98, 35, 49, 16, 24, 12,  6,  3,  1
    },
    {
    0,  0,126,126, 24, 60,102, 66,  0, 12, 28,112,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128,
    0,  0,  0,  0,192, 96, 48, 24, 12,132,198, 98,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  0,
    0,  0,252, 15,  1,  0,248, 14, 31,109,140,148,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  0,
    0,  0, 31,120,192,  0, 15, 56,124,219,152, 20,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  0,
    32, 16, 16, 16, 17, 11, 14, 12, 24, 16, 49, 35, 98,102, 68, 68, 71, 71, 71, 68, 68,102, 98, 35, 49, 16, 24, 12,  6,  3,  1
    },
    {
    0,  0,126,126, 24, 60,102, 66,  0, 12, 28,112,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128,
    0,  0,  0,  0,192, 96, 48, 24, 12,132,198, 98,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  0,
    0,  0,252, 15,  1,  0,248, 14, 31,109,140,148,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  0,
    0,  0, 31,120,192,  0, 15, 56,124,219,152, 20,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  0,
    32, 16, 16, 16, 17, 11, 14, 12, 24, 16, 49, 35, 98,102, 68, 68, 71, 71, 71, 68, 68,102, 98, 35, 49, 16, 24, 12,  6,  3,  1
    }
};

static const char PROGMEM tap[TAP_FRAMES][ANIM_SIZE] = {
    {
    0,  0,126,126, 24, 60,102, 66,  0, 12, 28,112,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128,
    0,  0,  0,  0,192, 96, 48, 24, 12,132,198, 98,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  0,
    0,  0,252, 15,  1,  0,248, 14, 31,109,140,148,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  0,
    0,  0, 31,120,192,  0, 15, 56,124,219,152, 20,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  0,
    32, 16, 16, 16, 17, 11, 14, 12, 24, 16, 49, 35,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  0
    },
    {
    0,  0,126,126, 24, 60,102, 66,  0, 12, 28,112,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128,
    0,  0,  0,  0,192, 96, 48, 24, 12,132,198, 98,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  0,
    0,  0,252, 15,  1,  0,248, 14, 31,109,140,148,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  0,
    0,  0, 31,120,192,  0, 15, 56,124,219,152, 20,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  0,
    32, 16, 16, 16, 17, 11, 14, 12, 24, 16, 49, 35,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 24
    },
};

oled_rotation_t oled_init_user(oled_rotation_t rotation) {
    return OLED_ROTATION_180;
}

static void render_status(void) {
    oled_clear();
    current_idle_frame = (current_idle_frame + 1) % IDLE_FRAMES;
    oled_write_raw_P(idle[abs((IDLE_FRAMES-1)-current_idle_frame)], 543);
    oled_set_cursor(0,6);
    oled_write_P(PSTR("    Layer: "), false);
    switch (get_highest_layer(layer_state)) {
        case _LAYER0:
            oled_write_P(PSTR("QWERTY"), false);
            break;
        case _LAYER1:
            oled_write_P(PSTR("LOGIC"), false);
            break;
        case _LAYER2:
            oled_write_P(PSTR("FINAL CUT"), false);
            break;
    }
}

bool process_record_user(uint16_t keycode, keyrecord_t *record) {
    switch (keycode) {
        case KC_A ... KC_H:
        case KC_Q ... KC_T:
        case KC_V ... KC_X:
        case KC_Z ... KC_6:
        case KC_GRAVE:
            if (record->event.pressed) {
                oled_write_raw_P(tap[1], ANIM_SIZE);
            } else {
                oled_write_raw_P(idle[1], 543);
                anim_timer = timer_read32();
            }
            break;
        case KC_I ... KC_P:
        case KC_U:
        case KC_Y:
        case KC_7 ... KC_0:
        case KC_MINUS ... KC_BSLASH:
        case KC_SCOLON ... KC_QUOTE:
        case KC_COMMA ... KC_SLASH:
            if (record->event.pressed) {
                oled_write_raw_P(tap[0], ANIM_SIZE);
            } else {
                oled_write_raw_P(idle[2], 543);
                anim_timer = timer_read32();
            }
            break;
    }
    return true;
};
void suspend_wakeup_init_user(void) {
    oled_write_raw_P(idle[0], 543);
    render_status();
}
void oled_task_user(void) {
    if(timer_elapsed32(anim_timer) > 200) {
        anim_timer = timer_read32();
        render_status();
    }
}
#endif

